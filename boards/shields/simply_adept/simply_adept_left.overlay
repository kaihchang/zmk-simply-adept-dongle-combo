#include "simply_adept.dtsi"
#include "simply_adept-layouts.dtsi"

/ {
    kscan0: kscan {
        compatible = "zmk,kscan-gpio-direct";
        input-gpios =
            <&gpio1 0 (GPIO_ACTIVE_LOW | GPIO_PULL_UP)>, // sw_1
            <&gpio0 20 (GPIO_ACTIVE_LOW | GPIO_PULL_UP)>, // sw_2
            <&gpio0 6 (GPIO_ACTIVE_LOW | GPIO_PULL_UP)>, // sw_3
            <&gpio0 29 (GPIO_ACTIVE_LOW | GPIO_PULL_UP)>, // sw_4
            <&gpio0 31 (GPIO_ACTIVE_LOW | GPIO_PULL_UP)>, // sw_5
            <&gpio1 4 (GPIO_ACTIVE_LOW | GPIO_PULL_UP)>, // sw_6
            <&gpio0 22 (GPIO_ACTIVE_LOW | GPIO_PULL_UP)>, // sw_7
            <&gpio0 2 (GPIO_ACTIVE_LOW | GPIO_PULL_UP)>, // sw_8
            <&gpio0 17 (GPIO_ACTIVE_LOW | GPIO_PULL_UP)>, // sw_9
            <&gpio1 15 (GPIO_ACTIVE_LOW | GPIO_PULL_UP)>, // sw_10
            <&gpio1 6 (GPIO_ACTIVE_LOW | GPIO_PULL_UP)>, // sw_11
            <&gpio1 13 (GPIO_ACTIVE_LOW | GPIO_PULL_UP)>, // sw_12
            <&gpio0 24 (GPIO_ACTIVE_LOW | GPIO_PULL_UP)>, // sw_13
            <&gpio0 11 (GPIO_ACTIVE_LOW | GPIO_PULL_UP)>, // sw_14
            <&gpio1 11 (GPIO_ACTIVE_LOW | GPIO_PULL_UP)>, // sw_15
            <&gpio0 9 (GPIO_ACTIVE_LOW | GPIO_PULL_UP)>, // sw_16
            <&gpio0 10 (GPIO_ACTIVE_LOW | GPIO_PULL_UP)>; // sw_17
        wakeup-source;
    };
};

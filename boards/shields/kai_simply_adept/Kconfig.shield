## boards/shields/kai_simply_adept/Kconfig.shield
```kconfig
config SHIELD_KAI_SIMPLY_ADEPT_LEFT
    def_bool $(shields_list_contains,kai_simply_adept_left)

config SHIELD_KAI_SIMPLY_ADEPT_RIGHT
    def_bool $(shields_list_contains,kai_simply_adept_right)

config SHIELD_KAI_SIMPLY_ADEPT_DONGLE
    def_bool $(shields_list_contains,kai_simply_adept_dongle)

config SHIELD_KAI_SIMPLY_ADEPT_TRACKBALL
    def_bool $(shields_list_contains,kai_simply_adept_trackball)
```

## boards/shields/simply_adept/Kconfig.defconfig
```kconfig
if SHIELD_SIMPLY_ADEPT_LEFT || SHIELD_SIMPLY_ADEPT_RIGHT || SHIELD_SIMPLY_ADEPT_DONGLE || SHIELD_SIMPLY_ADEPT_TRACKBALL
config ZMK_SPLIT
    default y
config ZMK_POINTING
    default y
endif

if SHIELD_SIMPLY_ADEPT_DONGLE
config ZMK_KEYBOARD_NAME
    default "Simply Adept"
config ZMK_SPLIT_ROLE_CENTRAL
    default y
# Set this to the number of peripherals your dongle will have.
# For a unibody, this would be 1. If you have left and right halves, set it to 2, etc.
config ZMK_SPLIT_BLE_CENTRAL_PERIPHERALS
    default 3
endif

if SHIELD_SIMPLY_ADEPT_TRACKBALL
config SPI
    default y
endif
```

## boards/shields/simply_adept/Kconfig.shield
```kconfig
config SHIELD_SIMPLY_ADEPT_LEFT
    def_bool $(shields_list_contains,simply_adept_left)

config SHIELD_SIMPLY_ADEPT_RIGHT
    def_bool $(shields_list_contains,simply_adept_right)

config SHIELD_SIMPLY_ADEPT_DONGLE
    def_bool $(shields_list_contains,simply_adept_dongle)

config SHIELD_SIMPLY_ADEPT_TRACKBALL
    def_bool $(shields_list_contains,simply_adept_trackball)
```

## config/west.yml
```yaml
manifest:
  remotes:
    - name: zmkfirmware
      url-base: https://github.com/zmkfirmware
    # Additional modules containing boards/shields/custom code can be listed here as well
    # See https://docs.zephyrproject.org/3.2.0/develop/west/manifest.html#projects
    - name: caksoylar
      url-base: https://github.com/caksoylar
    - name: badjeff
      url-base: https://github.com/badjeff/
    - name: efogdev
      url-base: https://github.com/efogdev
    - name: oleksandrmaslov
      url-base: https://github.com/oleksandrmaslov
    - name: not-in-stock
      url-base: https://github.com/not-in-stock/

  projects:
    - name: zmk
      remote: zmkfirmware
      revision: v0.3
      import: app/west.yml
    - name: zmk-rgbled-widget
      remote: caksoylar
      revision: main
    - name: zmk-pmw3610-driver
      remote: efogdev
      revision: main
    - name: zmk-input-processor-report-rate-limit
      remote: badjeff
      revision: main
    - name: zmk-input-processor-xyz
      remote: badjeff
      revision: main
    - name: zmk-pointing-acceleration
      remote: oleksandrmaslov
      revision: main
    - name: prospector-zmk-module
      remote: not-in-stock
      revision: add-display-sleep

  self:
    path: config
```

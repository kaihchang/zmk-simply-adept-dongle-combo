#include "kai_simply_adept.dtsi"
#include "kai_simply_adept-layouts.dtsi"

&default_transform {
    col-offset = <17>;
};

&kscan0 {
    input-gpios =
        <&gpio1 13 (GPIO_ACTIVE_LOW | GPIO_PULL_UP)>, // sw_22
        <&gpio0 29 (GPIO_ACTIVE_LOW | GPIO_PULL_UP)>, // sw_21
        <&gpio0 20 (GPIO_ACTIVE_LOW | GPIO_PULL_UP)>, // sw_20
        <&gpio0 17 (GPIO_ACTIVE_LOW | GPIO_PULL_UP)>, // sw_19
        <&gpio0 6 (GPIO_ACTIVE_LOW | GPIO_PULL_UP)>, // sw_18
        <&gpio0 10 (GPIO_ACTIVE_LOW | GPIO_PULL_UP)>, // sw_27
        <&gpio0 2 (GPIO_ACTIVE_LOW | GPIO_PULL_UP)>, // sw_26
        <&gpio0 22 (GPIO_ACTIVE_LOW | GPIO_PULL_UP)>, // sw_25
        <&gpio0 31 (GPIO_ACTIVE_LOW | GPIO_PULL_UP)>, // sw_24
        <&gpio0 24 (GPIO_ACTIVE_LOW | GPIO_PULL_UP)>, // sw_23
        <&gpio0 9 (GPIO_ACTIVE_LOW | GPIO_PULL_UP)>, // sw_32
        <&gpio1 11 (GPIO_ACTIVE_LOW | GPIO_PULL_UP)>, // sw_31
        <&gpio1 15 (GPIO_ACTIVE_LOW | GPIO_PULL_UP)>, // sw_30
        <&gpio1 0 (GPIO_ACTIVE_LOW | GPIO_PULL_UP)>, // sw_29
        <&gpio0 11 (GPIO_ACTIVE_LOW | GPIO_PULL_UP)>, // sw_28
        <&gpio1 6 (GPIO_ACTIVE_LOW | GPIO_PULL_UP)>, // sw_34
        <&gpio1 4 (GPIO_ACTIVE_LOW | GPIO_PULL_UP)>; // sw_33
};
